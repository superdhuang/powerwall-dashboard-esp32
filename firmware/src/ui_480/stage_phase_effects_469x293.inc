// Generated native 469x293 phase effects retained as firmware source data.
const StageMoonPixel kStageMoonPixels[] = {
  {395, 33, {0x18c3, 0x18c3, 0x18c3, 0x18c3, 0x18c3, 0x18c3, 0x18c3, 0x18c3}},
  {397, 33, {0x18c3, 0x18c3, 0x18c3, 0x18c3, 0x18c3, 0x18c3, 0x18c3, 0x18c3}},
  {391, 34, {0x18c3, 0x18c3, 0x18c3, 0x18c3, 0x18c3, 0x18c3, 0x18c3, 0x18c3}},
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  {386, 68, {0x18c3, 0x18c3, 0x18c3, 0x18c3, 0x18c3, 0x18c3, 0x18c3, 0x18c3}},
};
const size_t kStageMoonPixelCount = sizeof(kStageMoonPixels) / sizeof(kStageMoonPixels[0]);

const float kStageSolarUvMinX = -0.529296875f;
const float kStageSolarUvRangeX = 0.997314453f;
const float kStageSolarUvMinY = -0.246582031f;
const float kStageSolarUvRangeY = 0.511962891f;
const StageSolarSpan kStageSolarSpans[] = {
  {194, 45, 16, 156, 183, 9, 12, {43, 47, 67}, {42, 46, 67}, {12, 12, 26}, {12, 12, 26}},
  {210, 45, 16, 185, 214, 12, 14, {42, 46, 67}, {43, 47, 68}, {12, 11, 26}, {13, 12, 27}},
  {226, 45, 16, 216, 246, 14, 15, {43, 47, 68}, {43, 47, 68}, {12, 12, 27}, {12, 12, 27}},
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  {166, 145, 8, 2, 11, 254, 245, {46, 50, 72}, {34, 38, 55}, {13, 13, 28}, {10, 10, 21}},
};
const size_t kStageSolarSpanCount = sizeof(kStageSolarSpans) / sizeof(kStageSolarSpans[0]);
